#include <Arduino.h>
#include <Wire.h>
#include <Adafruit_GFX.h>
#include <U8g2lib.h>
#include <WiFi.h>


void OLED_Init(void);

void OLED_Clear(void);

#define MAX_LINES 3  // 最大显示行数
#define LINE_LENGTH 21  // 每行最大字符数

extern char terminal_buffer[MAX_LINES][LINE_LENGTH];  // 终端显示缓冲

// 动画帧数组
const char* loading_frames[] = {"|", "/", "-", "\\"};
const int FRAME_COUNT = 4;
static int current_frame = 0;



void Terminal_Init(void);  // 初始化终端
void Terminal_Update(void);  // 更新显示
void Terminal_WriteLine(const char* line);  // 写入新行
void Show_Connecting(bool* connected);  // 显示连接状态


/*****************************************************OLED引脚配置*****************************************************/

//硬件I2C，SCL=22, SDA=21
U8G2_SSD1305_128X32_NONAME_F_HW_I2C u8g2(U8G2_R0, /* reset=*/ U8X8_PIN_NONE);
//软件IIC
//U8G2_SSD1306_128X32_NONAME_F_SW_I2C u8g2(U8G2_R0,/* clock=*/ 22,/* data=*/  21,/* reset=*/ U8X8_PIN_NONE);
//软件SPI
//U8G2_SSD1306_128X64_NONAME_2_4W_SW_SPI u8g2(U8G2_R0, /* clock=*/4, /* data=*/19,/* cs=*/18, /* dc=*/5, /* reset=*/19);

/*****************************************************OLED引脚配置*****************************************************/


static const unsigned char LOGO_MINICAR[] U8X8_PROGMEM = 
{
    0x00, 0x00, 0x00, 0x00, 0x00, 0x00, 0x00, 0x00, 0x00, 0x00, 0x00, 0x04, 0x00, 0x00, 0x00, 0x00, 0x00, 0x00, 0x00, 0x00, 0x00, 0x00, 0x00, 0x00, 
    0x00, 0x00, 0x00, 0x06, 0x00, 0x00, 0x00, 0x00, 0x00, 0x00, 0x00, 0x00, 0x00, 0x00, 0x00, 0x00, 0x00, 0x00, 0x00, 0x03, 0x00, 0x00, 0x00, 0x00, 
    0x00, 0x00, 0x00, 0x00, 0x00, 0x00, 0x80, 0x01, 0x00, 0x00, 0x00, 0x03, 0x00, 0x00, 0x00, 0x00, 0x00, 0x00, 0x00, 0x00, 0x00, 0x00, 0x00, 0x0f, 
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    0x00, 0x00, 0x00, 0x00, 0x00, 0x00, 0x00, 0x00, 0x01, 0x00, 0x00, 0x00, 0x00, 0x00, 0x00, 0x00, 
    };
void OLED_Init()
{
    Wire.begin();  // 初始化I2C引脚
    u8g2.begin();
    u8g2.setPowerSave(0);  // 确保显示开启
    u8g2.setContrast(255); // 设置最大对比度
    u8g2.clearBuffer();
    int y = (64 - 46) / 2;  // OLED高度64，图像高度46
    
    u8g2.firstPage();
    do {
        u8g2.drawXBMP(0, y, 128, 46, LOGO_MINICAR);
    } while(u8g2.nextPage());
}

void OLED_Clear(void)
{
    u8g2.firstPage();
    do {
        // 不绘制任何内容，自动清屏
    } while(u8g2.nextPage());
}

char terminal_buffer[MAX_LINES][LINE_LENGTH] = {0};  // 终端显示缓冲区

void Terminal_Init(void)
{
    u8g2.setFont(u8g2_font_5x8_tr);  // 使用5x8像素字体
    memset(terminal_buffer, 0, sizeof(terminal_buffer));  // 清空缓冲区
}

void Terminal_Update(void)
{
    u8g2.firstPage();
    do {
        for(int i = 0; i < MAX_LINES; i++) {
            u8g2.setCursor(0, (i + 1) * 10);  // 每行间距10像素
            u8g2.print(terminal_buffer[i]);
        }
    } while(u8g2.nextPage());
}

void Terminal_WriteLine(const char* line)
{
    // 向上滚动现有内容
    for(int i = 0; i < MAX_LINES - 1; i++) {
        strncpy(terminal_buffer[i], terminal_buffer[i + 1], LINE_LENGTH - 1);
        terminal_buffer[i][LINE_LENGTH - 1] = '\0';  // 确保字符串结束
    }
    
    // 在最后一行写入新内容
    strncpy(terminal_buffer[MAX_LINES - 1], line, LINE_LENGTH - 1);
    terminal_buffer[MAX_LINES - 1][LINE_LENGTH - 1] = '\0';
    
    // 更新显示
    Terminal_Update();
}

/**
 * @brief 显示WiFi连接状态和动画
 * @param connected WiFi连接状态标志的指针
 * @param timeout 超时时间(毫秒)
 * @return 连接是否成功
 */
bool Show_Connecting(bool* connected, unsigned long timeout = 10000)
{
    OLED_Clear();
    const char* text = "Connecting ";
    u8g2.setFont(u8g2_font_7x14B_tr);
    
    // 计算文本位置
    int strWidth = u8g2.getStrWidth(text);
    int xPos = (128 - strWidth - 6) / 2;
    int yPos = 32;
    
    // 记录开始时间
    unsigned long startTime = millis();
    
    // 动画循环，直到连接成功或超时
    while(millis() - startTime < timeout) {
        // 检查连接状态
        if(*connected) {
            OLED_Clear();
            Terminal_WriteLine("WiFi Connected!");
            return true;
        }
        
        // 显示动画
        u8g2.firstPage();
        do {
            // 显示文本
            u8g2.setCursor(xPos, yPos);
            u8g2.print(text);
            
            // 显示动画帧
            u8g2.setCursor(xPos + strWidth, yPos);
            u8g2.print(loading_frames[current_frame]);
        } while(u8g2.nextPage());
        
        // 更新动画帧
        current_frame = (current_frame + 1) % FRAME_COUNT;
        delay(100);  // 控制动画速度
    }
    
    // 连接超时
    OLED_Clear();
    Terminal_WriteLine("WiFi Connect Failed!");
    return false;
}

void Show_Logo(void)  // 显示Logo
{
    OLED_Init();
    u8g2.drawXBMP(0, 0, 128, 64, LOGO_MINICAR);
    delay(2000);
}

int8_t Check_WiFi_Status(void) {
    static uint8_t prevStatus = WL_CONNECTED;  // 静态变量保存上一状态
    uint8_t currentStatus = WiFi.status();     // 获取当前状态
    
    // 仅当状态从连接变为断开时触发
    if (prevStatus == WL_CONNECTED && currentStatus != WL_CONNECTED) {
        Terminal_WriteLine("WiFi Lost");
    }
    
    // 更新状态记录
    prevStatus = currentStatus;
    
    return 1;
}

